## conf/layer.conf
```bitbake
# We have a conf and classes directory, add to BBPATH
BBPATH .= ":${LAYERDIR}"

# We have a recipes-* directories, add to BBFILES
BBFILES += "${LAYERDIR}/recipes-*/*/*.bb \
	${LAYERDIR}/recipes-*/*/*.bbappend"

BBFILE_COLLECTIONS += "orangepiplus"
BBFILE_PATTERN_orangepiplus = "^${LAYERDIR}/"
BBFILE_PRIORITY_orangepiplus = "6"
```

## conf/machine/orangepiplus.conf
```bitbake
#@TYPE: Machine
#@NAME: orangepiplus

#@DESCRIPTION: Machine configuration for orangepiplus systems

PREFERRED_PROVIDER_virtual/xserver ?= "xserver-xorg"
PREVERRED_VERSION_xserver-xorg ?= "1.15.1"
XSERVER ?= "xserver-xorg \
           xf86-input-evdev \
           xf86-input-mouse \
           xf86-video-fbdev \
           xf86-video-fbturbo \
           xf86-video-mali \
           xf86-input-keyboard \
           xserver-xorg-module-exa \
           xserver-xorg-extension-glx \
           xserver-xorg-multimedia-modules"

MACHINE_EXTRA_RDEPENDS = "kernel-modules kernel-firmware modload-config scriptbin mali libmali libump libdri2"
MACHINE_EXTRA_RRECOMMENDS = ""
IMAGE_INSTALL_append = " kernel-modules modload-config libump libmali mesa-megadriver glmark2"
IMAGE_INSTALL_remove = "libegl-mesa libgles1-mesa libgles2-mesa libegl-mesa-dev libgles1-mesa-dev libgles2-mesa-dev"

IMAGE_CLASSES += "sdcard_image-orangepiplus"

DEFAULTTUNE ?= "cortexa7hf-neon-vfpv4"
include conf/machine/include/tune-cortexa7.inc

IMAGE_FSTYPES += "tar.bz2 ext4 allwinner-sdcard"
#EXTRA_IMAGECMD_jffs2 = "-lnp "

SERIAL_CONSOLE = "115200 ttyS0"

CHIP_NAME = "sun8iw7p1"

PREFERRED_PROVIDER_virtual/kernel ?= "linux"
PREFERRED_PROVIDER_virtual/mali ?= "mali"
PREFERRED_PROVIDER_libump ?= "mali"
PREFERRED_PROVIDER_libmali ?= "mali"
PREFERRED_VERSION_linux ?= "3.4%"
PREFERRED_PROVIDER_jpeg ?= "libjpeg-turbo"
PREFERRED_PROVIDER_jpeg-native ?= "libjpeg-turbo-native"

KERNEL_IMAGETYPE = "uImage"
#KERNEL_DEVICETREE = "sun8i-h3-orangepi-plus.dtb"
KERNEL_EXTRA_ARGS += "LOADADDR=${UBOOT_ENTRYPOINT}"

FATPAYLOAD += "${SCRIPTBIN_FILES}"

#SPL_BINARY = "MLO"
UBOOT_SUFFIX = "bin"
UBOOT_MACHINE = "${CHIP_NAME}_config"
UBOOT_ENTRYPOINT = "0x40008000"
UBOOT_LOADADDRESS = "0x40008000"
#PREFERRED_VERSION_u-boot = "2011.09-lichee"
#PREFERRED_VERSION_u-boot = "v2015.01+gitAUTOINC+e5ceeca211"
#PREFERRED_VERSION_u-boot = "binary"

UBOOT_ENV = "uEnv"
UBOOT_ENV_SUFFIX = "txt"

BOOT0_TYPE ?= "sdcard"
BOOT0_IMAGE ?= "boot0_${BOOT0_TYPE}_${CHIP_NAME}.bin"
BOOT0_SUFFIX = "bin"

SCRIPTBIN_SELECTED ?= "1080p60_hdmi"

MACHINE_FEATURES_append = "usbgadget usbhost vfat alsa ext2 irda keyboard screen serial \
	wifi touchscreen"

IMAGE_BOOT_FILES ?= "u-boot.${UBOOT_SUFFIX} "

SDIMG_COMPRESSION = "gzip"
```

## recipes-bsp/u-boot/Orangepiplus_defconfig
```kconfig
CONFIG_ARM=y
CONFIG_ARCH_SUNXI=y
CONFIG_MACH_SUN8I=y
CONFIG_DRAM_CLK=672
CONFIG_USB1_VBUS_PIN="PL2"
CONFIG_USB2_VBUS_PIN="PG13"
CONFIG_VIDEO_VGA=y
CONFIG_VIDEO_COMPOSITE=y
CONFIG_GMAC_TX_DELAY=3
CONFIG_DEFAULT_DEVICE_TREE="sun8i-h3-orangepi-plus"
# CONFIG_SYS_MALLOC_CLEAR_ON_INIT is not set
CONFIG_SPL=y
CONFIG_SYS_EXTRA_OPTIONS="SUNXI_GMAC,RGMII,MACPWR=SUNXI_GPH(23),AHCI"
# CONFIG_CMD_IMLS is not set
# CONFIG_CMD_FLASH is not set
# CONFIG_CMD_FPGA is not set
CONFIG_ETH_DESIGNWARE=y
CONFIG_USB_EHCI_HCD=y
```
